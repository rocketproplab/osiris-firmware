## SET-temp/components/discrete_in/Kconfig
```kconfig
menu "Discrete inputs (Blue Raven staging / recovery)"

config DISCRETE_IN_MIN_INTERVAL_MS
    int "Minimum interval between accepted edges (ms, 0 = accept every edge)"
    range 0 5000
    default 50
    help
        An edge arriving sooner than this after the last ACCEPTED one is
        counted as suppressed and otherwise ignored. The first edge is
        always accepted, with its exact ISR-captured timestamp -- this
        only ever discards what FOLLOWS a real signal.

        This is not cosmetic. These tasks run at the highest priority in
        the system (FC_PRIO_DISCRETE, above the sensor readers), and
        each accepted edge writes a console line and pushes an event to
        the card and the downlink. An input that chatters therefore
        starves everything below it: a floating GPIO23 on the bench
        produced ~6700 edges/s and timed out the I2C sensor reads, which
        looked like a bus fault and was not one.

        A Blue Raven cannot assert the same line twice within 50 ms, and
        staging and recovery are separate pins with separate counters,
        so the default cannot discard a real deployment signal. Lower it
        only if you have a specific reason to expect faster genuine
        pulses on ONE line.

        0 restores the old accept-everything behaviour.

choice DISCRETE_IN_MODE
    prompt "How a Blue Raven line is read"
    default DISCRETE_IN_MODE_ANALOG
    help
        ANALOG (default): the ADC reads each line's voltage every
        DISCRETE_IN_SAMPLE_MS and compares it with this page's thresholds.
        Needed on this vehicle: the Blue Raven runs from 1S, and with a 2k
        series resistor its lines measure ~2.86 V idle and 3.7 V fired
        (2026-10-10). Both are above the digital HIGH level (fixed in the
        silicon), so a digital input would never see the change.

        DIGITAL: the original GPIO rising-edge interrupt. Exact ISR
        timestamps, but only works when idle is well below ~0.8 V and
        fired well above ~2.5 V at the pin.

config DISCRETE_IN_MODE_ANALOG
    bool "Analog: ADC with voltage thresholds"

config DISCRETE_IN_MODE_DIGITAL
    bool "Digital: GPIO rising-edge interrupt"

endchoice

config DISCRETE_IN_DIVIDER_TOP_OHMS
    int "Series resistor, line to pin (ohms)"
    depends on DISCRETE_IN_MODE_ANALOG
    range 0 1000000
    default 2000
    help
        R6 (staging) / R9 (recovery). Both lines use the same values.
        Only used to convert the pin voltage back to the line voltage when
        there IS a resistor to ground below; with none, the pin sees the
        line voltage directly (no current flows into the ADC input).

config DISCRETE_IN_DIVIDER_BOTTOM_OHMS
    int "Resistor, pin to ground (ohms; 0 = none fitted)"
    depends on DISCRETE_IN_MODE_ANALOG
    range 0 1000000
    default 0
    help
        R5 (staging) / R8 (recovery). 0 means no resistor to ground: the
        pin reads the line voltage 1:1, which is the 2k-series setup of
        2026-10-10.

        The ADC tops out around 3.1 V at the pin. A FIRE threshold must be
        below that at the pin or it can never be seen -- the boot log says
        so in red. A fired level ABOVE full scale is fine: it reads as
        full scale, which is still above the threshold. What must NOT clip
        is the idle level, or idle and fired look the same.

        CHECK THESE AGAINST A METER: the boot log prints each line's
        reading at start ("line reads N mV"). With the resistors set
        right it matches what a meter on the line shows.

config DISCRETE_IN_STAGING_FIRE_MV
    int "Staging: FIRED at or above (mV on the Blue Raven line)"
    depends on DISCRETE_IN_MODE_ANALOG
    range 100 30000
    default 3000
    help
        On the line, where a meter reads it. Default 3.0 V: above the
        ~2.86 V idle, and 0.7 V below the 3.7 V fired level, so a 1S
        Blue Raven battery sagging while it drives an e-match is still
        seen down to 3.0 V.

        The margin that is SMALL is the idle side (~0.14 V). If the idle
        level creeps up -- a different e-match, a different resistor --
        check the boot log's reading against this.

config DISCRETE_IN_STAGING_RELEASE_MV
    int "Staging: idle again at or below (mV on the Blue Raven line)"
    depends on DISCRETE_IN_MODE_ANALOG
    range 0 30000
    default 2950
    help
        Below the fire threshold, so noise on a line sitting near one
        threshold cannot make an edge per wobble (hysteresis). Must stay
        above the idle level (~2.86 V) or the line can never return to
        idle after a firing. Clamped to the fire threshold if set above.

config DISCRETE_IN_RECOVERY_FIRE_MV
    int "Recovery: FIRED at or above (mV on the Blue Raven line)"
    depends on DISCRETE_IN_MODE_ANALOG
    range 100 30000
    default 3000

config DISCRETE_IN_RECOVERY_RELEASE_MV
    int "Recovery: idle again at or below (mV on the Blue Raven line)"
    depends on DISCRETE_IN_MODE_ANALOG
    range 0 30000
    default 2950

config DISCRETE_IN_SAMPLE_MS
    int "Sample period (ms)"
    depends on DISCRETE_IN_MODE_ANALOG
    range 1 50
    default 2
    help
        How often each line is read. Sets the timestamp resolution of a
        detected firing, together with the confirm count below.

config DISCRETE_IN_CONFIRM_SAMPLES
    int "Consecutive samples needed to change state"
    depends on DISCRETE_IN_MODE_ANALOG
    range 1 50
    default 3
    help
        A firing is believed after this many samples in a row at or above
        the fire threshold (6 ms at the defaults). The recorded time is
        that of the FIRST of them.

config DISCRETE_IN_INTERNAL_PULLDOWN
    bool "Enable the internal pulldown on discrete inputs"
    depends on DISCRETE_IN_MODE_DIGITAL
    default n
    help
        OFF for flight, and for any build running on PCB v1.

        The board already holds each input low through its divider
        (R5/R8 on staging, R8/R9 on recovery). Enabling the internal
        pulldown (~45k) in parallel with those shifts the divider ratio
        from 0.434 to 0.415, which raises the voltage the Blue Raven
        must produce before the pin reads HIGH -- it makes a real
        trigger HARDER to see, and the window in PCB_v1_wiring.md
        assumes 0.434.

        Turn it ON only when the divider is not present -- a bare module
        on a breadboard, for instance -- where the pin would otherwise
        float and generate thousands of spurious edges a second.

endmenu
```

## SET-temp/components/sensor_bus/Kconfig
```kconfig
menu "SET sensor bus (BMP388 + LSM6DSOX)"

    choice SET_SENSOR_BUS
        prompt "Interface"
        default SET_SENSOR_BUS_I2C
        help
            Both sensors share the same three wires (GPIO54, GPIO19, GPIO18),
            so they run as one bus or the other -- never a mix.

            SPI IS NOT IMPLEMENTED YET. Selecting it builds, but every
            transfer returns ESP_ERR_NOT_SUPPORTED and no sensor comes up.
            I2C is the default until the SPI branch of sensor_bus.c is
            filled in.

            AFTER CHANGING THIS, REMOVE ALL POWER (battery and USB) before
            testing. The BMP388 switches itself to SPI the first time its CS
            pin goes low and stays in SPI until it loses power. Pressing reset
            on the ESP32 does not cut power to the sensors.

        config SET_SENSOR_BUS_SPI
            bool "SPI (NOT IMPLEMENTED -- stubs only)"

        config SET_SENSOR_BUS_I2C
            bool "I2C (working)"
    endchoice

    config SET_SENSOR_SPI_FREQ_HZ
        int "SPI clock (Hz)"
        depends on SET_SENSOR_BUS_SPI
        range 100000 10000000
        default 1000000
        help
            Kept so the SPI branch has a clock to use once it is written.
            Both sensors allow up to 10 MHz. 1 MHz moves a full IMU sample in
            about 0.1 ms and is far more forgiving of long wires and breakout
            level-shifters. Raise it only after the chip-ID check passes.

    config SET_SENSOR_I2C_FREQ_HZ
        int "I2C clock (Hz)"
        depends on SET_SENSOR_BUS_I2C
        range 100000 400000
        default 400000
        help
            400 kHz is the fastest standard I2C speed both sensors support.
            Drop to 100000 if the bus scan at boot finds nothing.

endmenu
```

## SET-temp/components/telemetry/Kconfig
```kconfig
menu "XBee telemetry link"

    choice TELEMETRY_XBEE_MODE
        prompt "XBee serial mode"
        default TELEMETRY_XBEE_API
        help
            How the flight computer talks to the XBee over the UART. This
            must match the AP setting stored IN THE MODULE (set it with
            XCTU). The firmware never changes AP itself.

            This is the VEHICLE radio only. The ground radio can be in
            either mode, independently: the RF bytes on the air are the
            same. Tell the ground station which (--transparent, or the
            "transparent radio" box).

        config TELEMETRY_XBEE_API
            bool "API mode (AP=1) -- normal"
            help
                Every packet goes out in a 0x10 frame and every uplink
                command arrives in a 0x90 frame. Gives the boot-time ATVR
                check, the once-a-second ATDB uplink RSSI, and delivery
                status for unicast packets.

        config TELEMETRY_XBEE_TRANSPARENT
            bool "Transparent mode (AP=0) -- backup"
            help
                The packets are written to the UART as plain bytes and the
                module sends them to its stored destination (DH/DL; the
                factory default is broadcast). Uplink packets are found in
                the incoming byte stream by their magic byte, length and
                CRC.

                What you lose: the uplink RSSI field reads 0 (unknown), no
                delivery status, so no firmware retries (the radio's own
                MAC retries still apply), and the destination comes from
                the module, not the firmware. Packet format, commands and
                config upload are unchanged.

                Module settings (XCTU): AP=0, BD=115200 (or whatever this
                board uses), DH/DL = the ground radio or broadcast, and
                leave RO (packetization timeout) at its default.
    endchoice

    config TELEMETRY_XBEE_RETRY_MS
        int "Keep retrying an unverified radio every N ms (0 = off)"
        range 0 60000
        default 2000
        help
            If the boot check could not verify the radio, the telemetry
            task keeps trying in the background: it sends the bootloader
            escape (in case the module is sitting in its bootloader), waits
            for it to start, then asks again -- ATVR in API mode, +++ /
            ATVR / ATCN in transparent mode. It stops the moment the radio
            answers, and STATUS_FLAG_TELEM_OK comes on.

            Only in STANDBY. Never once the vehicle is ARMED or flying: in
            transparent mode each try puts a few stray bytes on the air and
            pauses the downlink for about 2.5 s while in command mode.

            Transparent builds retry only if the +++ boot check is enabled.

    config TELEMETRY_XBEE_TRANSPARENT_VERIFY
        bool "Check the radio at boot with +++ / ATVR"
        depends on TELEMETRY_XBEE_TRANSPARENT
        default y
        help
            Enters command mode once at boot (guard time, +++, ATVR, ATDH,
            ATDL, ATCN) to prove a radio is there and log where it will
            send. Costs about 2.5 s of boot time. Without it the radio is
            reported as unverified (STATUS_FLAG_TELEM_OK clear) and
            telemetry is sent blind.

    config TELEMETRY_XBEE_GUARD_MS
        int "Command-mode guard time (ms)"
        depends on TELEMETRY_XBEE_TRANSPARENT_VERIFY
        range 100 5000
        default 1100
        help
            Silence held before and after +++. Must be LONGER than the
            module's GT setting (default 1000 ms). If you shorten GT in
            XCTU, you can shorten this to match and save boot time.

endmenu
```
